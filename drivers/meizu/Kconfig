## drivers/meizu/Kconfig
```kconfig
config MEIZU_CLASS
	bool "Meizu class device driver"
	help
		This option provides the Meizu class device driver.
```

## drivers/misc/mediatek/accelerometer/lis3dh-new/Kconfig
```kconfig
config MTK_LIS3DH_NEW
	bool "MTK_LIS3DH_NEW for MediaTek package"
	default n
	help
		It support different accelerometer sensor.
		If this option is set, it will support LIS3DH Accelerometer.
```

## drivers/misc/mediatek/touchkey/Kconfig
```kconfig
config MTK_TOUCHKEY
	bool CONFIG_MTK_TOUCHKEY
	default n
	help
		CONFIG_MTK_TOUCHKEY

config MTK_TOUCHKEY_AW9201_SUPPORT
	bool "AW9201 Touchkey Driver"
	default n
	help
		AW9201 touch key (mBack)

config MTK_TOUCHKEY_AW9201_COMPATIBLE
	bool "AW9201 Touchkey Compatible"
	default n
```
